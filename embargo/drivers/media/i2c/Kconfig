## embargo/drivers/media/i2c/Kconfig
```kconfig
config VIDEO_AR0822
	tristate "Innodisk AR0822 sensor support"
	depends on VIDEO_DEV && I2C
	select VIDEO_V4L2_SUBDEV_API
	depends on MEDIA_CAMERA_SUPPORT
	help
	  This is a Video4Linux2 sensor driver for the Innodisk
	  AR0822 camera.

	  To compile this driver as a module, choose M here: the
	  module will be called ar0822.
```
